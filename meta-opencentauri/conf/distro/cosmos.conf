## meta-opencentauri/conf/distro/cosmos.conf
```bitbake
require conf/distro/poky.conf

DISTRO = "cosmos"
DISTRO_NAME = "Cosmos-Nebula"
DISTRO_VERSION = "0.0.7"

MAINTAINER = "cosmos-nebula contributors"

PACKAGE_CLASSES = "package_ipk"
DISTRO_FEATURES:remove = "ptest"

DISTRO_FEATURES:append = " rust"
RUST_VERSION = "1.92.0"
CARGO_VERSION = "1.92.0"

hostname:pn-base-files = "cosmos-nebula"
```
